## build/Kconfig/Kconfig.modules
```kconfig
menu "pcf85063a (/Users/dinordi/zephyrproject/pcf85063a)"
osource "/Users/dinordi/zephyrproject/pcf85063a/Kconfig"
config ZEPHYR_PCF85063A_MODULE
	bool
	default y
endmenu
menu "acpica (/Users/dinordi/zephyrproject/modules/lib/acpica)"
osource "$(ZEPHYR_ACPICA_KCONFIG)"
config ZEPHYR_ACPICA_MODULE
	bool
	default y
endmenu
menu "canopennode (/Users/dinordi/zephyrproject/modules/lib/canopennode)"
osource "$(ZEPHYR_CANOPENNODE_KCONFIG)"
config ZEPHYR_CANOPENNODE_MODULE
	bool
	default y
endmenu
menu "chre (/Users/dinordi/zephyrproject/modules/lib/chre)"
osource "/Users/dinordi/zephyrproject/modules/lib/chre/platform/zephyr/Kconfig"
config ZEPHYR_CHRE_MODULE
	bool
	default y
endmenu
menu "cmsis (/Users/dinordi/zephyrproject/modules/hal/cmsis)"
osource "$(ZEPHYR_CMSIS_KCONFIG)"
config ZEPHYR_CMSIS_MODULE
	bool
	default y
endmenu
menu "fatfs (/Users/dinordi/zephyrproject/modules/fs/fatfs)"
osource "$(ZEPHYR_FATFS_KCONFIG)"
config ZEPHYR_FATFS_MODULE
	bool
	default y
endmenu
menu "hal_ambiq (/Users/dinordi/zephyrproject/modules/hal/ambiq)"
osource "$(ZEPHYR_HAL_AMBIQ_KCONFIG)"
config ZEPHYR_HAL_AMBIQ_MODULE
	bool
	default y
endmenu
menu "hal_espressif (/Users/dinordi/zephyrproject/modules/hal/espressif)"
osource "/Users/dinordi/zephyrproject/modules/hal/espressif/zephyr/Kconfig"
config ZEPHYR_HAL_ESPRESSIF_MODULE
	bool
	default y
endmenu
menu "hal_ethos_u (/Users/dinordi/zephyrproject/modules/hal/ethos_u)"
osource "$(ZEPHYR_HAL_ETHOS_U_KCONFIG)"
config ZEPHYR_HAL_ETHOS_U_MODULE
	bool
	default y
endmenu
menu "hal_gigadevice (/Users/dinordi/zephyrproject/modules/hal/gigadevice)"
osource "$(ZEPHYR_HAL_GIGADEVICE_KCONFIG)"
config ZEPHYR_HAL_GIGADEVICE_MODULE
	bool
	default y
endmenu
menu "hal_infineon (/Users/dinordi/zephyrproject/modules/hal/infineon)"
osource "$(ZEPHYR_HAL_INFINEON_KCONFIG)"
config ZEPHYR_HAL_INFINEON_MODULE
	bool
	default y
endmenu
menu "hal_nordic (/Users/dinordi/zephyrproject/modules/hal/nordic)"
osource "$(ZEPHYR_HAL_NORDIC_KCONFIG)"
config ZEPHYR_HAL_NORDIC_MODULE
	bool
	default y
endmenu
menu "hal_nxp (/Users/dinordi/zephyrproject/modules/hal/nxp)"
osource "$(ZEPHYR_HAL_NXP_KCONFIG)"
config ZEPHYR_HAL_NXP_MODULE
	bool
	default y
endmenu
menu "hal_rpi_pico (/Users/dinordi/zephyrproject/modules/hal/rpi_pico)"
osource "$(ZEPHYR_HAL_RPI_PICO_KCONFIG)"
config ZEPHYR_HAL_RPI_PICO_MODULE
	bool
	default y
endmenu
menu "silabs (/Users/dinordi/zephyrproject/modules/hal/silabs)"
osource "/Users/dinordi/zephyrproject/modules/hal/silabs/zephyr/Kconfig"
config ZEPHYR_SILABS_MODULE
	bool
	default y
endmenu
menu "hal_telink (/Users/dinordi/zephyrproject/modules/hal/telink)"
osource "/Users/dinordi/zephyrproject/modules/hal/telink/Kconfig"
config ZEPHYR_HAL_TELINK_MODULE
	bool
	default y
endmenu
menu "liblc3 (/Users/dinordi/zephyrproject/modules/lib/liblc3)"
osource "$(ZEPHYR_LIBLC3_KCONFIG)"
config ZEPHYR_LIBLC3_MODULE
	bool
	default y
endmenu
menu "littlefs (/Users/dinordi/zephyrproject/modules/fs/littlefs)"
osource "$(ZEPHYR_LITTLEFS_KCONFIG)"
config ZEPHYR_LITTLEFS_MODULE
	bool
	default y
endmenu
menu "loramac-node (/Users/dinordi/zephyrproject/modules/lib/loramac-node)"
osource "$(ZEPHYR_LORAMAC_NODE_KCONFIG)"
config ZEPHYR_LORAMAC_NODE_MODULE
	bool
	default y
endmenu
menu "lvgl (/Users/dinordi/zephyrproject/modules/lib/gui/lvgl)"
osource "/Users/dinordi/zephyrproject/modules/lib/gui/lvgl/Kconfig"
config ZEPHYR_LVGL_MODULE
	bool
	default y
endmenu
menu "lz4 (/Users/dinordi/zephyrproject/modules/lib/lz4)"
osource "$(ZEPHYR_LZ4_KCONFIG)"
config ZEPHYR_LZ4_MODULE
	bool
	default y
endmenu
menu "mbedtls (/Users/dinordi/zephyrproject/modules/crypto/mbedtls)"
osource "$(ZEPHYR_MBEDTLS_KCONFIG)"
config ZEPHYR_MBEDTLS_MODULE
	bool
	default y
endmenu
menu "nanopb (/Users/dinordi/zephyrproject/modules/lib/nanopb)"
osource "$(ZEPHYR_NANOPB_KCONFIG)"
config ZEPHYR_NANOPB_MODULE
	bool
	default y
endmenu
menu "openthread (/Users/dinordi/zephyrproject/modules/lib/openthread)"
osource "$(ZEPHYR_OPENTHREAD_KCONFIG)"
config ZEPHYR_OPENTHREAD_MODULE
	bool
	default y
endmenu
menu "picolibc (/Users/dinordi/zephyrproject/modules/lib/picolibc)"
osource "/Users/dinordi/zephyrproject/modules/lib/picolibc/zephyr/Kconfig"
config ZEPHYR_PICOLIBC_MODULE
	bool
	default y
endmenu
menu "segger (/Users/dinordi/zephyrproject/modules/debug/segger)"
osource "$(ZEPHYR_SEGGER_KCONFIG)"
config ZEPHYR_SEGGER_MODULE
	bool
	default y
endmenu
menu "sof (/Users/dinordi/zephyrproject/modules/audio/sof)"
osource "/Users/dinordi/zephyrproject/modules/audio/sof/zephyr/Kconfig"
config ZEPHYR_SOF_MODULE
	bool
	default y
endmenu
menu "tflite-micro (/Users/dinordi/zephyrproject/modules/lib/tflite-micro)"
osource "$(ZEPHYR_TFLITE_MICRO_KCONFIG)"
config ZEPHYR_TFLITE_MICRO_MODULE
	bool
	default y
endmenu
menu "TraceRecorder (/Users/dinordi/zephyrproject/modules/debug/TraceRecorder)"
osource "/Users/dinordi/zephyrproject/modules/debug/TraceRecorder/kernelports/Zephyr/Kconfig"
config ZEPHYR_TRACERECORDER_MODULE
	bool
	default y
endmenu
menu "trusted-firmware-m (/Users/dinordi/zephyrproject/modules/tee/tf-m/trusted-firmware-m)"
osource "$(ZEPHYR_TRUSTED_FIRMWARE_M_KCONFIG)"
config ZEPHYR_TRUSTED_FIRMWARE_M_MODULE
	bool
	default y
endmenu
menu "trusted-firmware-a (/Users/dinordi/zephyrproject/modules/tee/tf-a/trusted-firmware-a)"
osource "$(ZEPHYR_TRUSTED_FIRMWARE_A_KCONFIG)"
config ZEPHYR_TRUSTED_FIRMWARE_A_MODULE
	bool
	default y
endmenu
menu "uoscore-uedhoc (/Users/dinordi/zephyrproject/modules/lib/uoscore-uedhoc)"
osource "$(ZEPHYR_UOSCORE_UEDHOC_KCONFIG)"
config ZEPHYR_UOSCORE_UEDHOC_MODULE
	bool
	default y
endmenu
menu "zcbor (/Users/dinordi/zephyrproject/modules/lib/zcbor)"
osource "$(ZEPHYR_ZCBOR_KCONFIG)"
config ZEPHYR_ZCBOR_MODULE
	bool
	default y
endmenu
menu "zscilib (/Users/dinordi/zephyrproject/modules/lib/zscilib)"
osource "/Users/dinordi/zephyrproject/modules/lib/zscilib/Kconfig.zscilib"
config ZEPHYR_ZSCILIB_MODULE
	bool
	default y
endmenu
menu "thrift (/Users/dinordi/zephyrproject/modules/lib/thrift)"
osource "$(ZEPHYR_THRIFT_KCONFIG)"
config ZEPHYR_THRIFT_MODULE
	bool
	default y
endmenu
```
